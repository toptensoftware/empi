## build/conf/local.conf
```bitbake
# CONF_VERSION is increased each time build/conf/ changes incompatibly and is used to
# track the version of this file when it was generated. This can safely be ignored if
# this doesn't mean anything to you.
CONF_VERSION = "2"

# Machine
MACHINE = "raspberrypi0-wifi"

# Distro
DISTRO = "empi"
EXTRA_IMAGE_FEATURES ?= "debug-tweaks"
IMAGE_FSTYPES += "wic"

# Packages
IMAGE_INSTALL:append = " linux-firmware-rpidistro-bcm43430"
IMAGE_INSTALL:append = " wpa-supplicant"
IMAGE_INSTALL:append = " kernel-modules"
IMAGE_INSTALL:append = " dropbear-host-keys"
IMAGE_INSTALL:append = " authorized-keys"
IMAGE_INSTALL:append = " kmscube"
IMAGE_INSTALL:append = " zmach"
IMAGE_INSTALL:append = " iproute2"
IMAGE_INSTALL:append = " iputils"
IMAGE_INSTALL:append = " gdb gdbserver"

# Accept license for Raspberry Pi WiFi/Bluetooth firmware
LICENSE_FLAGS_ACCEPTED += "synaptics-killswitch"

# Use BusyBox init instead of systemd
DISTRO_FEATURES:remove = "systemd"
DISTRO_FEATURES:remove = "wayland vulkan x11"
DISTRO_FEATURES_BACKFILL_CONSIDERED:append = " systemd"
VIRTUAL-RUNTIME_init_manager = "busybox"
VIRTUAL-RUNTIME_initscripts = "initscripts"
VIRTUAL-RUNTIME_login_manager = "busybox"
VIRTUAL-RUNTIME_dev_manager = "busybox-mdev"

# Enable SSH server
IMAGE_FEATURES += "ssh-server-dropbear"

# Set hostname
hostname:pn-base-files = "empi"

# Deploy initramfs to boot partition
IMAGE_BOOT_FILES:append = " initramfs-image-${MACHINE}.rootfs.cpio.lz4;initramfs.cpio.lz4"

# Add dependency on initramfs image
do_image_wic[depends] += "initramfs-image:do_image_complete"

# UART
ENABLE_UART = "0"
SERIAL_CONSOLES = ""

CMDLINE = ""



##################################################################################
## Build related
##################################################################################

# Performance settings (adjust based on your CPU)
BB_NUMBER_THREADS = "6"
PARALLEL_MAKE = "-j 6"

# Save disk space by removing temporary work files
INHERIT += "rm_work"


#
# Additional image features
#
# The following is a list of additional classes to use when building images which
# enable extra features. Some available options which can be included in this variable
# are:
#   - 'buildstats' collect build statistics
USER_CLASSES ?= "buildstats"

#
# Interactive shell configuration
#
# Under certain circumstances the system may need input from you and to do this it
# can launch an interactive shell. It needs to do this since the build is
# multithreaded and needs to be able to handle the case where more than one parallel
# process may require the user's attention. The default is iterate over the available
# terminal types to find one that works.
#
# Examples of the occasions this may happen are when resolving patches which cannot
# be applied, to use the devshell or the kernel menuconfig
#
# Supported values are auto, gnome, xfce, rxvt, screen, konsole (KDE 3.x only), none
# Note: currently, Konsole support only works for KDE 3.x due to the way
# newer Konsole versions behave
#OE_TERMINAL = "auto"
# By default disable interactive patch resolution (tasks will just fail instead):
PATCHRESOLVE = "noop"

#
# Disk Space Monitoring during the build
#
# Monitor the disk space during the build. If there is less that 1GB of space or less
# than 100K inodes in any key build location (TMPDIR, DL_DIR, SSTATE_DIR), gracefully
# shutdown the build. If there is less than 100MB or 1K inodes, perform a hard halt
# of the build. The reason for this is that running completely out of space can corrupt
# files and damages the build in ways which may not be easily recoverable.
# It's necessary to monitor /tmp, if there is no space left the build will fail
# with very exotic errors.
BB_DISKMON_DIRS ??= "\
    STOPTASKS,${TMPDIR},1G,100K \
    STOPTASKS,${DL_DIR},1G,100K \
    STOPTASKS,${SSTATE_DIR},1G,100K \
    STOPTASKS,/tmp,100M,100K \
    HALT,${TMPDIR},100M,1K \
    HALT,${DL_DIR},100M,1K \
    HALT,${SSTATE_DIR},100M,1K \
    HALT,/tmp,10M,1K"
```

## meta-empi/conf/distro/empi.conf
```bitbake
require conf/distro/poky.conf

DISTRO = "empi"
DISTRO_NAME = "Emulator Pi"

# Remove the Poky warning message
DISTRO_FEATURES:remove = "ptest"
```

## meta-empi/conf/layer.conf
```bitbake
# Layer configuration for meta-empi
BBPATH .= ":${LAYERDIR}"

BBFILES += "${LAYERDIR}/recipes-*/*/*.bb \
            ${LAYERDIR}/recipes-*/*/*.bbappend"

BBFILE_COLLECTIONS += "meta-empi"
BBFILE_PATTERN_meta-empi = "^${LAYERDIR}/"
BBFILE_PRIORITY_meta-empi = "10"

LAYERDEPENDS_meta-empi = "core"
LAYERSERIES_COMPAT_meta-empi = "scarthgap"
```
